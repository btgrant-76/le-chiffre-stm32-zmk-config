## config/west.yml
```yaml
manifest:
  remotes:
    - name: zmkfirmware
      url-base: https://github.com/zmkfirmware
    - name: petejohanson
      url-base: https://github.com/petejohanson
    - name: urob
      url-base: https://github.com/urob
  projects:
    - name: zmk
      remote: petejohanson
      revision: core/move-to-zephyr-4-1
      import: app/west.yml
    - name: zmk-leader-key
      remote: urob
      revision: main
  self:
    path: config
```
